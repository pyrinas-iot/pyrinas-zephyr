## Kconfig.pyrinas
```kconfig
#
# Copyright (c) 2022 Circuit Dojo LLC
#
# SPDX-License-Identifier: Apache-2.0
#

menu "Pyrinas"

config PYRINAS
	select QCBOR
	bool "Enable Pyrinas"
	help
		This option enables Pyrinas functions.

if PYRINAS

rsource "lib/Kconfig"

endif

endmenu
```

## lib/Kconfig
```kconfig
#
# Copyright (c) 2020 Circuit Dojo LLC
#
# SPDX-License-Identifier: Apache-2.0
#

menu "Pyrinas Library"

rsource "shell/Kconfig"
rsource "ble/Kconfig"
rsource "cloud/Kconfig"

endmenu
```

## lib/ble/Kconfig
```kconfig
#
# Copyright (c) 2020 Circuit Dojo LLC
#
# SPDX-License-Identifier: Apache-2.0
#

menu "Pyrinas Library"

config PYRINAS_BLUETOOTH_ENABLED
	select BT
	select BT_EXT_ADV
	select BT_SETTINGS
	bool "Enable Pyrinas Bluetooth LR Hub"
	help
		This option enables Pyrinas overall.

if PYRINAS_BLUETOOTH_ENABLED

config PYRINAS_BLUETOOTH_WORKQUEUE_STACK_SIZE
	int "Bluetooth workqueue stack size"
	default 4096

config PYRINAS_BLUETOOTH_WORKQUEUE_PRIORITY
	int "Bluetooth workqueue priority"
	default SYSTEM_WORKQUEUE_PRIORITY

choice
	prompt "Bluetooth Mode"
	default PYRINAS_PERIPH_ENABLED
	help
		Select from which Pyrinas mode to use. Central or Peripheral.

config PYRINAS_CENTRAL_ENABLED
	bool "Use Pyrinas in Central Mode"
	select BT_SMP
	select BT_CENTRAL
	select BT_GATT_CLIENT
	help
		Use Pyrinas in Central Mode.

config PYRINAS_PERIPH_ENABLED
	bool "Use Pyrinas in Peripheral Mode"
	help
		Use Pyrinas in as a Peripheral Client

endchoice

endif

endmenu
```

## lib/shell/Kconfig
```kconfig
#
# Copyright (c) 2022 Circuit Dojo LLC
#
# SPDX-License-Identifier: Apache-2.0
#

menuconfig PYRINAS_AT_SHELL
	bool "AT Shell"
	depends on NRF_MODEM_LIB
	depends on SHELL
	help
	  Adds the AT command capability to shell. The shell command is called
	  "at" and will interpret arguments as AT commands, and print back the
	  response from the modem.

if PYRINAS_AT_SHELL

config AT_SHELL_CMD_RESPONSE_MAX_LEN
	int "Maximum AT command response length"
	default 2700

endif # PYRINAS_AT_SHELL

menuconfig PYRINAS_CREDENTIALS_SHELL
	bool "Credentials shell."
	depends on SETTINGS
	depends on SHELL
	help
	  Adds the ability to set TLS credentials via shell.

menuconfig PYRINAS_SETTINGS_SHELL
	bool "Settings Shell"
	depends on SETTINGS
	depends on SHELL
	help
	  Adds the ability to set settings via shell.
```

## subsys/Kconfig
```kconfig
rsource "pyrinas_cloud/Kconfig"
rsource "cellular/Kconfig"
rsource "comms/Kconfig"
```

## subsys/comms/Kconfig
```kconfig
menu "Pyrinas Bi-Directional UART Comms"

config PYRINAS_BIDI_COMMS
	bool "Enable Pyrinas Bidirectional UART Comms"
	help
		This option enables Pyrinas Bi-directional comms functions.

endmenu
```

## subsys/pyrinas_cloud/Kconfig
```kconfig
#
# Copyright (c) 2018 Nordic Semiconductor
#
# SPDX-License-Identifier: LicenseRef-BSD-5-Clause-Nordic
#

menu "Pyrinas Cloud"

config PYRINAS_CLOUD_ENABLED
	select MQTT_LIB
	select MQTT_LIB_TLS
	bool "Enable Pyrinas MQTT Cloud"
	help
		This option enables Pyrinas Cloud functions.

if PYRINAS_CLOUD_ENABLED

config PYRINAS_CLOUD_WORKQUEUE_STACK_SIZE
	int "Pyrinas Cloud workqueue stack size"
	default 4096

config PYRINAS_CLOUD_WORKQUEUE_PRIORITY
	int "Pyrinas Cloud workqueue priority"
	default SYSTEM_WORKQUEUE_PRIORITY

config PYRINAS_CLOUD_PROVISION_CERTIFICATES
	bool "nRF Cloud library provision of certificate"
	select MODEM_KEY_MGMT if NRF_MODEM_LIB
	help
		Enable run-time provisioning of certificates from the
		certificates header file selected by using NRF_CLOUD_CERTIFICATES_FILE

config PYRINAS_CLOUD_SEC_TAG
	int "Security tag to use for the connection"
	default 1234

config PYRINAS_CLOUD_HTTPS_SEC_TAG
	int "Security tag to use for HTTPS connection"
	default 1235

config PYRINAS_CLOUD_PEER_VERIFY
	int "Peer verify parameter for mqtt_client"
	default 2
	help
			Set to 0 for VERIFY_NONE, 1 for VERIFY_OPTIONAL, and 2 for VERIFY_REQUIRED.

config PYRINAS_CLOUD_PASSWORD
	string "MQTT password for authentication"

config PYRINAS_CLOUD_USER_NAME
	string "MQTT user name for autentication"

config PYRINAS_CLOUD_MQTT_OTA_SUB_TOPIC
	string "MQTT ota subscribe topic"
	default "%.*s/ota/sub"

config PYRINAS_CLOUD_MQTT_OTA_PUB_TOPIC
	string "MQTT ota publish topic"
	default "%.*s/ota/pub"

config PYRINAS_CLOUD_MQTT_TELEMETRY_PUB_TOPIC
	string "MQTT publish topic"
	default "%.*s/tel/pub"

config PYRINAS_CLOUD_MQTT_APPLICATION_PUB_TOPIC
	string "Application MQTT publish topic"
	default "%.*s/app/pub/%.*s"

config PYRINAS_CLOUD_MQTT_APPLICATION_SUB_TOPIC
	string "Application MQTT subscribe topic"
	default "%.*s/app/sub/%.*s"

config PYRINAS_CLOUD_MQTT_BROKER_HOSTNAME
	string "MQTT broker hostname"
	default "mqtt.yourhost.com"

config PYRINAS_CLOUD_MQTT_BROKER_PORT
	int "MQTT broker port"
	default 8884

config PYRINAS_CLOUD_MQTT_MESSAGE_BUFFER_SIZE
	int "MQTT message buffer size"
	default 512

config PYRINAS_CLOUD_MQTT_TOPIC_SIZE
	int "MQTT topic size"
	default 128

config PYRINAS_CLOUD_MQTT_PAYLOAD_SIZE
	int "MQTT payload size"
	default 512

config PYRINAS_CLOUD_MQTT_TELEMETRY_SIZE
	int "MQTT payload size"
	default 48

config PYRINAS_CLOUD_APPLICATION_CALLBACK_MAX_COUNT
	int "Max application callback count."
	default 10

config PYRINAS_CLOUD_APPLICATION_EVENT_NAME_MAX_SIZE
	int "Max size of the callback name."
	default 16

config PYRINAS_APP_VERSION_MAJOR
	int "Major verison number"
	default 1

config PYRINAS_APP_VERSION_MINOR
	int "Minor verison number"
	default 0

config PYRINAS_APP_VERSION_PATCH
	int "Patch verison number"
	default 0

config PYRINAS_APP_VERSION_COMMIT
	int "Commit verison number"
	default 0

config PYRINAS_APP_VERSION_HASH
	string "Version hash provided by Git"
	default ""

endif

endmenu
```

## west.yml
```yaml
# Pryinas west.yml
manifest:
  projects:
    - name: qcbor
      url: https://github.com/jaredwolff/QCBOR.git
      revision: dev
      path: modules/lib/qcbor
  self:
    path: modules/lib/pyrinas
```
