## CMakeLists.txt
```
#
# Copyright (c) 2020 Circuit Dojo LLC
#
# SPDX-License-Identifier: Apache-2.0
#

cmake_minimum_required(VERSION 3.13.4)

find_package(Zephyr REQUIRED HINTS $ENV{ZEPHYR_BASE})

find_package(Git QUIET)
if(GIT_FOUND)
  execute_process(
    COMMAND ${GIT_EXECUTABLE} describe --tags --long
    WORKING_DIRECTORY                ${CMAKE_CURRENT_LIST_DIR}
    OUTPUT_VARIABLE                  version
    OUTPUT_STRIP_TRAILING_WHITESPACE
    ERROR_STRIP_TRAILING_WHITESPACE
    ERROR_VARIABLE                   stderr
    RESULT_VARIABLE                  return_code
  )
  if(return_code)
    message(STATUS "git describe failed: ${stderr}; ${KERNEL_VERSION_STRING} will be used instead")
  elseif(CMAKE_VERBOSE_MAKEFILE)
    message(STATUS "git describe stderr: ${stderr}")
  endif()
endif()

if(version)
  string(REGEX REPLACE "^([0-9]+).*$" "\\1" version_major ${version})
  string(REGEX REPLACE "^[0-9]+\.([0-9]+).*$" "\\1" version_minor "${version}")
  string(REGEX REPLACE "^[0-9]+\.[0-9]+\.([0-9]+).*$" "\\1" version_patch "${version}")
  string(REGEX REPLACE "^[0-9]+\.[0-9]+\.[0-9]+-([0-9]+)-.*$" "\\1" version_commit "${version}")
  string(REGEX REPLACE "^[0-9]+\.[0-9]+\.[0-9]+-[0-9]+-(.*)$" "\\1" version_hash "${version}")

  zephyr_compile_definitions(PYRINAS_APP_VERSION_MAJOR=${version_major})
  zephyr_compile_definitions(PYRINAS_APP_VERSION_MINOR=${version_minor})
  zephyr_compile_definitions(PYRINAS_APP_VERSION_PATCH=${version_patch})
  zephyr_compile_definitions(PYRINAS_APP_VERSION_COMMIT=${version_commit})
  zephyr_compile_definitions(PYRINAS_APP_VERSION_HASH=${version_hash})

  message(STATUS "Version: ${version_major}.${version_minor}.${version_patch}-${version_commit}-${version_hash}")
endif()

# Name the project
project(pyrinas_cloud_sample)

# Get th source
FILE(GLOB app_sources src/*.c)
FILE(GLOB app_weak_sources ${PYRINAS_DIR}/lib/app/*.c)

target_sources(app PRIVATE ${app_sources} ${app_weak_sources})

# Add external Rust lib directory
set(pyrinas_codec_example_dir   ${CMAKE_CURRENT_SOURCE_DIR}/lib)
set(pyrinas_codec_example_include_dir   ${CMAKE_CURRENT_SOURCE_DIR}/lib/include)

# Add the library
add_library(pyrinas_codec_example_lib STATIC IMPORTED GLOBAL)

# Set the paths
set_target_properties(pyrinas_codec_example_lib PROPERTIES IMPORTED_LOCATION             ${pyrinas_codec_example_dir}/libpyrinas_codec_example.a)
set_target_properties(pyrinas_codec_example_lib PROPERTIES INTERFACE_INCLUDE_DIRECTORIES ${pyrinas_codec_example_include_dir})

# Link them!
target_link_libraries(app PUBLIC pyrinas_codec_example_lib -Wl,--allow-multiple-definition)
```

## Kconfig
```
#
# Copyright (c) 2020 Circuit Dojo LLC
#
# SPDX-License-Identifier: Apache-2.0
#

mainmenu "Pyrinas Configuration"

comment "Pyrinas-specific configuration options"

config APPLICATION_WORKQUEUE_STACK_SIZE
	int "Application workqueue stack size"
	default 4096

config APPLICATION_WORKQUEUE_PRIORITY
	int "Application workqueue priority"
	default SYSTEM_WORKQUEUE_PRIORITY

source "Kconfig.zephyr"
```

## prj.conf
```kconfig
# defaults
CONFIG_LOG=y
CONFIG_LOG_IMMEDIATE=y
CONFIG_ASSERT=y
CONFIG_HW_STACK_PROTECTION=y
CONFIG_REBOOT=y
CONFIG_RESET_ON_FATAL_ERROR=y

# Stackin' and heapin'
CONFIG_MAIN_STACK_SIZE=2048
CONFIG_HEAP_MEM_POOL_SIZE=1024
CONFIG_SYSTEM_WORKQUEUE_STACK_SIZE=2048

# Enable debug
CONFIG_DEBUG=y

# Enable Zephyr application to be booted by MCUboot
CONFIG_BOOTLOADER_MCUBOOT=y

# Modem library
CONFIG_NRF_MODEM_LIB=y
CONFIG_NRF_MODEM_LIB_SYS_INIT=n

# PDP Context
CONFIG_LTE_LINK_CONTROL=y
CONFIG_LTE_AUTO_INIT_AND_CONNECT=n

# Network
CONFIG_NETWORKING=y
CONFIG_NET_SOCKETS=y
CONFIG_NET_NATIVE=n

# Modem info
CONFIG_MODEM_INFO=y

# MQTT
CONFIG_MQTT_LIB=y
CONFIG_MQTT_LIB_TLS=y
CONFIG_MQTT_KEEPALIVE=55

# Pyrinas Cloud
CONFIG_PYRINAS_CLOUD_ENABLED=y
CONFIG_PYRINAS_CLOUD_PROVISION_CERTIFICATES=y
CONFIG_PYRINAS_CLOUD_MQTT_BROKER_HOSTNAME="pyrinas-dev.jaredwolff.com"
CONFIG_PYRINAS_CLOUD_MQTT_BROKER_PORT=8883

# Topics with debug prefix
CONFIG_PYRINAS_CLOUD_MQTT_OTA_PUB_TOPIC="%.*s/ota/pub"
CONFIG_PYRINAS_CLOUD_MQTT_OTA_SUB_TOPIC="%.*s/ota/sub"
CONFIG_PYRINAS_CLOUD_MQTT_TELEMETRY_PUB_TOPIC="%.*s/tel/pub"
CONFIG_PYRINAS_CLOUD_MQTT_APPLICATION_PUB_TOPIC="%.*s/app/pub/%.*s"
CONFIG_PYRINAS_CLOUD_MQTT_APPLICATION_SUB_TOPIC="%.*s/app/sub/%.*s"

# FOTA library
CONFIG_FOTA_DOWNLOAD=y

# Download client
CONFIG_DOWNLOAD_CLIENT=y
CONFIG_DOWNLOAD_CLIENT_STACK_SIZE=4096

# Image manager
CONFIG_IMG_MANAGER=y
CONFIG_FLASH=y
CONFIG_IMG_ERASE_PROGRESSIVELY=y

# DFU Target
CONFIG_DFU_TARGET=y

# Modem key management
CONFIG_MODEM_KEY_MGMT=y

# Watchdog
CONFIG_WATCHDOG=y
```

## src/app.c
```c
#include <app/app_includes.h>
#include <worker/worker.h>

#include <zephyr.h>
#include <device.h>
#include <devicetree.h>
#include <nrfx.h>

#include <pyrinas_codec.h>
#include <comms/comms.h>

#include <app/version.h>

#include <libpyrinas_codec_example.h>

#include <logging/log.h>
LOG_MODULE_REGISTER(app);

/* Delayed application work*/
static struct k_work publish_work;

static void publish_timer_evt(struct k_timer *timer);
K_TIMER_DEFINE(publish_timer, publish_timer_evt, NULL);

static void publish_timer_evt(struct k_timer *timer)
{
  /* Start work */
  worker_submit(&publish_work);
}

static void publish_work_fn()
{
  /* Create request */
  EnvironmentData data = {
      .temperature = 1000,
      .humidity = 3000,
  };

  /* Encode the data with our sample library */
  Encoded encoded = encode_environment_data(&data);

  /* If we have valid encoded data, publish it.*/
  if (encoded.resp == Ok)
  {
    /* Request config */
    pyrinas_cloud_publish("env", encoded.data, encoded.size);
  }
}

void application_callback(const uint8_t *topic, size_t topic_len, const uint8_t *data, size_t data_len)
{
  LOG_INF("Application: Topic: %s Len: %d", topic, data_len);
}

void setup(void)
{
  /* Message! */
  LOG_INF("Start of Pyrinas Sample!");

  uint8_t ver[64];
  get_version_string(ver, sizeof(ver));
  LOG_INF("Version: %s", ver);

  /* Setup callback for certain events */
  pyrinas_cloud_subscribe("cmd", application_callback);
  pyrinas_cloud_subscribe("cfg", application_callback);

  /* Work */
  k_work_init(&publish_work, publish_work_fn);

  /* Start timer */
  k_timer_start(&publish_timer, K_MINUTES(10), K_NO_WAIT);
}
```

## src/version.c
```c
#include <stdio.h>
#include <app/version.h>

const union pyrinas_cloud_ota_version pyrinas_version = {
    .major = PYRINAS_APP_VERSION_MAJOR,
    .minor = PYRINAS_APP_VERSION_MINOR,
    .patch = PYRINAS_APP_VERSION_PATCH,
    .commit = PYRINAS_APP_VERSION_COMMIT,
    .hash = STRINGIFY(PYRINAS_APP_VERSION_HASH),
};

int get_version_string(uint8_t *p_buf, const size_t size)
{
    return snprintf(p_buf, size, "%d.%d.%d-%d-%.*s", pyrinas_version.major, pyrinas_version.minor, pyrinas_version.patch, pyrinas_version.commit, sizeof(pyrinas_version.hash), pyrinas_version.hash);
}
```
