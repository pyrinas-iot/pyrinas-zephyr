## CMakeLists.txt
```
#
# Copyright (c) 2020 Circuit Dojo LLC
#
# SPDX-License-Identifier: Apache-2.0
#

cmake_minimum_required(VERSION 3.8.2)

find_package(Zephyr REQUIRED HINTS $ENV{ZEPHYR_BASE})

project(pyrinas_client)

FILE(GLOB app_sources src/*.c)

target_sources(app PRIVATE ${app_sources} ${PYRINAS_DIR}/lib/app/main.c)
```

## Kconfig
```
# Copyright (c) 2017-2020 Linaro Limited
# Copyright (c) 2020 Arm Limited
#
# SPDX-License-Identifier: Apache-2.0
#

mainmenu "Pyrinas Configuration"

comment "Pyrinas-specific configuration options"

config HCI_NCP_ENABLED
	bool "Initialize the AT Command driver during system init"
	default n
	help
		Enable HCI network connected processor mode

if HCI_NCP_ENABLED

	config HCI_NCP_RST_PORT
		string "Port connected to to reset for HCI device."
		default GPIO_0
		help
			Pin used to reset external HCI device.

	config HCI_NCP_RST_PIN
		int "Pin to reset external HCI device."
		default 0
		help
			Pin used to reset external HCI device.

endif

source "Kconfig.zephyr"
```

## prj.conf
```kconfig
# Stackin' and heapin'
CONFIG_MAIN_STACK_SIZE=8192
CONFIG_HEAP_MEM_POOL_SIZE=8192

# Enable console and printk()
CONFIG_PRINTK=y

# Let __ASSERT do its job
CONFIG_DEBUG=y
CONFIG_LOG=y
CONFIG_LOG_IMMEDIATE=y

# Enable Zephyr application to be booted by MCUboot
CONFIG_BOOTLOADER_MCUBOOT=y

# Ring buffer
CONFIG_RING_BUFFER=y

# Adding Peripherals
CONFIG_GPIO=y
# CONFIG_I2C=y
# CONFIG_I2C_2=y

# SPI Related
# CONFIG_SPI=y
# CONFIG_SPI_NOR=y
# CONFIG_SPI_NOR_FLASH_LAYOUT_PAGE_SIZE=4096

# Enable flash operations.
CONFIG_FLASH=y
CONFIG_FLASH_MAP=y
CONFIG_FLASH_PAGE_LAYOUT=y

# Enable the LittleFS file system.
# CONFIG_FILE_SYSTEM=y
# CONFIG_FILE_SYSTEM_LITTLEFS=y

# CONFIG_APP_WIPE_STORAGE=y

# For saving settings
CONFIG_SETTINGS=y
CONFIG_SETTINGS_NVS=y

# Non-volatile Storage
CONFIG_NVS=y

# MCUMgr for DFU
CONFIG_MCUMGR=y
CONFIG_MCUMGR_SMP_BT=y
CONFIG_MCUMGR_SMP_BT_AUTHEN=n
CONFIG_MCUMGR_CMD_IMG_MGMT=y

# Pyrinas related
CONFIG_PYRINAS_BLUETOOTH_ENABLED=y
CONFIG_PYRINAS_PERIPH_ENABLED=y

# Enable Bluetooth stack and libraries
CONFIG_BT=y
CONFIG_BT_HCI=y
CONFIG_BT_PERIPHERAL=y
CONFIG_BT_DEVICE_NAME="Pyrinas"
CONFIG_BT_GATT_CLIENT=y

# CONFIG_BT_RX_BUF_LEN=258
CONFIG_BT_ATT_TX_MAX=10
CONFIG_BT_ATT_PREPARE_COUNT=5

CONFIG_BT_L2CAP_TX_MTU=247
CONFIG_BT_L2CAP_RX_MTU=247
CONFIG_BT_L2CAP_TX_BUF_COUNT=10

# Enable ext adv
CONFIG_BT_EXT_ADV=y
CONFIG_BT_EXT_ADV_LEGACY_SUPPORT=y

# Link Layer
CONFIG_BT_LL_NRFXLIB=y
CONFIG_BT_MAX_CONN=2
CONFIG_BT_AUTO_PHY_UPDATE=n

# Pairing related
CONFIG_BT_SMP=y
CONFIG_BT_ECC=y
CONFIG_BT_SETTINGS=y
CONFIG_BT_MAX_PAIRED=1
# CONFIG_BT_SIGNING=y
CONFIG_BT_PRIVACY=y

CONFIG_BT_DEBUG_LOG=y
CONFIG_BT_DEBUG_SETTINGS=y
```

## boards/particle_xenon.conf
```kconfig
CONFIG_CONSOLE=y
CONFIG_LOG_BUFFER_SIZE=4096
CONFIG_RTT_CONSOLE=y
CONFIG_LOG_BACKEND_RTT=y
CONFIG_LOG_BACKEND_RTT_MODE_DROP=n
CONFIG_USE_SEGGER_RTT=y
CONFIG_SEGGER_RTT_BUFFER_SIZE_UP=4096
CONFIG_LOG_BACKEND_SHOW_COLOR=n
CONFIG_LOG_PROCESS_THREAD_STACK_SIZE=1024
CONFIG_LOG_STRDUP_BUF_COUNT=20
```

## src/app.c
```c
/*
 * Copyright (c) 2021 Circuit Dojo LLC
 *
 * SPDX-License-Identifier: Apache-2.0
 */

#include <app/app_includes.h>
#include <device.h>
#include <drivers/gpio.h>

#include <logging/log.h>
LOG_MODULE_REGISTER(app);

/*
 * Devicetree helper macro which gets the 'flags' cell from a 'gpios'
 * property, or returns 0 if the property has no 'flags' cell.
 */

#define FLAGS_OR_ZERO(node)                        \
  COND_CODE_1(DT_PHA_HAS_CELL(node, gpios, flags), \
              (DT_GPIO_FLAGS(node, gpios)),        \
              (0))

 /*
  * Get button configuration from the devicetree sw0 alias.
  *
  * At least a GPIO device and pin number must be provided. The 'flags'
  * cell is optional.
  */

#define SW0_NODE DT_ALIAS(sw0)

#if DT_NODE_HAS_STATUS(SW0_NODE, okay)
#define SW0_GPIO_LABEL DT_GPIO_LABEL(SW0_NODE, gpios)
#define SW0_GPIO_PIN DT_GPIO_PIN(SW0_NODE, gpios)
#define SW0_GPIO_FLAGS (GPIO_INPUT | FLAGS_OR_ZERO(SW0_NODE))
#else
#error "Unsupported board: sw0 devicetree alias is not defined"
#define SW0_GPIO_LABEL ""
#define SW0_GPIO_PIN 0
#define SW0_GPIO_FLAGS 0
#endif

static struct gpio_callback button_cb_data;
struct device *button;

static void my_expiry_function(struct k_timer *timer);
K_TIMER_DEFINE(my_timer, my_expiry_function, NULL);

char count[10];
int tx_counter = 0;

static void my_expiry_function(struct k_timer *timer)
{
    if (ble_is_connected())
    {
        snprintf(count, sizeof(count), "%i", tx_counter++);
        ble_publish("pong", count);
        LOG_INF("sending: \"%s\" \"%s\"", "pong", log_strdup(count));
    }

    k_timer_start(&my_timer, K_MSEC(500), K_NO_WAIT);
}

void evt_cb(char *name, char *data)
{
    LOG_INF("\"%s\" \"%s\"", log_strdup(name), log_strdup(data));
}

void button_pressed(struct device *dev, struct gpio_callback *cb,
    uint32_t pins)
{
    printk("Button pressed at %" PRIu32 "\n", k_cycle_get_32());
    // ble_erase_bonds();
}

static void config_button(void)
{
    int ret;

    button = device_get_binding(SW0_GPIO_LABEL);
    if (button == NULL)
    {
        printk("Error: didn't find %s device\n", SW0_GPIO_LABEL);
        return;
    }

    ret = gpio_pin_configure(button, SW0_GPIO_PIN, SW0_GPIO_FLAGS);
    if (ret != 0)
    {
        printk("Error %d: failed to configure %s pin %d\n",
            ret, SW0_GPIO_LABEL, SW0_GPIO_PIN);
        return;
    }

    ret = gpio_pin_interrupt_configure(button,
        SW0_GPIO_PIN,
        GPIO_INT_EDGE_TO_ACTIVE);
    if (ret != 0)
    {
        printk("Error %d: failed to configure interrupt on %s pin %d\n",
            ret, SW0_GPIO_LABEL, SW0_GPIO_PIN);
        return;
    }

    gpio_init_callback(&button_cb_data, button_pressed, BIT(SW0_GPIO_PIN));
    gpio_add_callback(button, &button_cb_data);
    printk("Set up button at %s pin %d\n", SW0_GPIO_LABEL, SW0_GPIO_PIN);
}

void setup(void)
{
    // Message!
    LOG_INF("Start of Pyrinas Client example!");

    // Config button
    config_button();

    // Default config for central mode
    BLE_STACK_PERIPH_DEF(init);

    /* BLE initialization */
    ble_stack_init(&init);

    // Subscribe to event
    ble_subscribe("ping", evt_cb);

    // Start message timer
    k_timer_start(&my_timer, K_SECONDS(1), K_NO_WAIT);
}

void loop(void)
{
    k_msleep(100);
}
```
